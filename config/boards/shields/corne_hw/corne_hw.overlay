/ {
    chosen {
        zmk,kscan = &kscan0;
    };
};

kscan0: kscan {
    compatible = "zmk,kscan-gpio-matrix";
    wakeup-source;

    diode-direction = "col2row";

    row-gpios
        = <&pro_micro 19 (GPIO_ACTIVE_HIGH | GPIO_PULL_DOWN)>
        , <&pro_micro 18 (GPIO_ACTIVE_HIGH | GPIO_PULL_DOWN)>
        , <&pro_micro 15 (GPIO_ACTIVE_HIGH | GPIO_PULL_DOWN)>
        , <&pro_micro 14 (GPIO_ACTIVE_HIGH | GPIO_PULL_DOWN)>
        ;
};